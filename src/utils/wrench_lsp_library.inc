{ "blank", "blank name;", "Declares a variable without a script-side initializer, typically a global the host fills in before running. It cannot be assigned in the same statement.", 3 },
{ "break", "break;", "Exits the innermost loop or switch immediately.", 3 },
{ "case", "case 1:", "Labels a branch inside a switch. Execution falls through into the next case unless it hits break.", 3 },
{ "continue", "continue;", "Skips the rest of the loop body and starts the next iteration of the innermost loop.", 3 },
{ "default", "default:", "The switch branch that runs when no case value matches.", 3 },
{ "do", "do { ... } while( cond );", "Loop that runs its body once, then repeats while the condition is non-zero.", 3 },
{ "else", "if( cond ) { ... } else { ... }", "Branch that runs when the preceding if condition is zero. Can be chained as else if.", 3 },
{ "enum", "enum Color { RED, GREEN = 5, BLUE }", "Defines compile-time int or float constants numbered from 0 or from the last explicit value. Members of a named enum are used as Color::RED.", 3 },
{ "export", "export function name( a ) { ... }", "Exports the next function so other scripts that import this bytecode can call it. Structs are always exported.", 3 },
{ "false", "false", "Built-in constant equal to 0.", 3 },
{ "float", "(float)x", "Cast that converts a value to a float, e.g. 10 / (float)n.", 3 },
{ "for", "for( var i = 0; i < n; ++i ) { ... }", "C-style loop. The foreach forms for( var v : c ) and for( var k, var v : c ) walk an array or hash table.", 3 },
{ "function", "function name( a, b ) { return a + b; }", "Declares a function. Missing arguments are 0 and extra arguments are ignored; without return it returns 0.", 3 },
{ "goto", "goto label;", "Jumps to a label (written as label:) in the same function.", 3 },
{ "if", "if( cond ) { ... }", "Runs the block when the condition is non-zero.", 3 },
{ "int", "(int)x", "Cast that converts a value to an int; floats are truncated toward zero.", 3 },
{ "new", "var s = new S( args ) { member = 1 };", "Creates a struct instance by running struct S as its constructor, with optional member initializers. new S[] { {}, {} } creates an array of instances.", 3 },
{ "null", "null", "Built-in constant equal to 0.", 3 },
{ "return", "return value;", "Leaves the current function and returns value, or 0 when no value is given.", 3 },
{ "struct", "struct S( a ) { var m = a; }", "Declares a struct: its body is the constructor and its variables become the members. Structs are always exported.", 3 },
{ "switch", "switch( x ) { case 0: break; default: break; }", "Multi-way branch on an expression with C semantics, including fall-through between cases.", 3 },
{ "true", "true", "Built-in constant equal to 1.", 3 },
{ "unit", "unit name( a ) { ... }", "Synonym for function.", 3 },
{ "var", "var x = 10;", "Declares a variable, local inside a function and global otherwise. var a[] = { 1, 2 }; declares an array.", 3 },
{ "while", "while( cond ) { ... }", "Loop that repeats while the condition is non-zero.", 3 },
{ "yield", "var r = yield( value );", "Suspends the script and returns control to the host with the given arguments. Evaluates to the value the host supplies when it resumes the script.", 3 },
{ "._count", "value._count", "Returns the number of elements in an array, characters in a string or entries in a hash table; 0 for other values.", 2 },
{ "._exists", "table._exists( key )", "Returns 1 if the hash table contains key, otherwise 0. Always 0 for values that are not hash tables.", 2 },
{ "._hash", "value._hash", "Returns the 32-bit hash of the value as an int. Ints and floats hash to their raw bits; strings and containers hash their contents.", 2 },
{ "._remove", "container._remove( key )", "Removes key from a hash table, or the element at index key from an array or string, shifting the rest down. Evaluates to the container.", 2 },
{ "print", "print( ... )", "Writes every argument converted to text, with no separator and no newline. Provided by the host (wrench CLI, debugger); returns nothing.", 0 },
{ "println", "println( ... )", "Writes every argument converted to text, followed by a newline. Provided by the host (wrench CLI, debugger).", 0 },
{ "array::clear", "array::clear( array, [size] )", "Turns the variable into a new array of size zero-valued elements (default 0), discarding old contents. Returns the array.", 0 },
{ "array::count", "array::count( array )", "Returns the number of elements in the array, or 0 if the argument is not a value array (strings give 0).", 0 },
{ "array::insert", "array::insert( array, where, [count] )", "Inserts count zero-valued elements (default 1) at index where, shifting later elements up; where past the end appends. Returns the array.", 0 },
{ "array::remove", "array::remove( array, where, [count] )", "Removes count elements (default 1) starting at index where, shifting later elements down. Returns the array.", 0 },
{ "array::truncate", "array::truncate( array, size )", "Shrinks the array to size elements if it is longer; does nothing if it is shorter. Returns the array.", 0 },
{ "debug::print", "debug::print( fmt, ... )", "Formats like str::format and sends the text to the attached debugger, without a newline. Does nothing when the target is built without debug code or no debugger is connected; output is cut at 199 chars.", 0 },
{ "debug::println", "debug::println( fmt, ... )", "Like debug::print but appends a newline. Does nothing without debug code in the target or a connected debugger; returns nothing.", 0 },
{ "hash::add", "hash::add( hash, item, key )", "Stores item under key, replacing any existing entry, and returns a reference to the stored item. Does nothing if the first argument is not a hash table.", 0 },
{ "hash::clear", "hash::clear( hash )", "Turns the variable into a new empty hash table, discarding old contents. Returns the table.", 0 },
{ "hash::count", "hash::count( hash )", "Returns the number of entries in the hash table, or 0 if the argument is not a hash table.", 0 },
{ "hash::exists", "hash::exists( hash, key )", "Returns non-zero (true) if key is present in the hash table, otherwise 0.", 0 },
{ "hash::remove", "hash::remove( hash, key )", "Removes key from the hash table. Returns non-zero (true) if the key was present, otherwise 0.", 0 },
{ "io::close", "io::close( fd )", "Closes a file descriptor returned by io::open. Returns 0 on success or -1 on error.", 0 },
{ "io::deleteFile", "io::deleteFile( name )", "Deletes (unlinks) the named file. Returns 0 on success or -1 on failure.", 0 },
{ "io::fsync", "io::fsync( fd )", "Commits buffered data for fd to disk. Returns 0 on success or -1 on error.", 0 },
{ "io::getline", "io::getline()", "Reads one line (up to 256 chars) from standard input and returns it as a string without the line end (LF, CR LF or CR). Returns the int -1 at the end of the input.", 0 },
{ "io::open", "io::open( name, [flags] )", "Opens a file in binary mode and returns a file descriptor, or -1 on failure. flags is an OR of io::O_* constants, default io::O_RDWR | io::O_CREAT.", 0 },
{ "io::read", "io::read( fd, count )", "Reads up to count bytes from fd and returns them as a string (may contain zeros) whose length is the number of bytes read.", 0 },
{ "io::readFile", "io::readFile( name )", "Reads the whole file in binary and returns its contents as a string (may contain zeros). Returns 0 if the file cannot be opened.", 0 },
{ "io::seek", "io::seek( fd, offset, [whence] )", "Moves the file position of fd; whence is io::SEEK_SET (default), io::SEEK_CUR or io::SEEK_END. Returns the new offset from the start, or -1 on error.", 0 },
{ "io::write", "io::write( fd, data, [count] )", "Writes the bytes of string data to fd, at most count bytes (default all). Returns the number of bytes written, or -1 on error and when data is not a string.", 0 },
{ "io::writeFile", "io::writeFile( name, data )", "Creates or overwrites the named file with the bytes of string data. Returns 1 on success, 0 on failure.", 0 },
{ "list::clear", "list::clear( list )", "Turns the variable into a new empty list (an array); call it before pushing. Returns the list.", 0 },
{ "list::count", "list::count( list )", "Returns the number of elements in the list.", 0 },
{ "list::peek", "list::peek( list )", "Returns the first element without removing it, or 0 if the list is empty.", 0 },
{ "list::pop", "list::pop( list )", "Removes and returns the first element, or returns 0 if the list is empty. Same as list::pop_front.", 0 },
{ "list::pop_back", "list::pop_back( list )", "Removes and returns the last element, or returns 0 if the list is empty.", 0 },
{ "list::pop_front", "list::pop_front( list )", "Removes and returns the first element, or returns 0 if the list is empty.", 0 },
{ "list::push", "list::push( list, item )", "Inserts item at the front of the list. Same as list::push_front; returns nothing.", 0 },
{ "list::push_back", "list::push_back( list, item )", "Appends item to the end of the list. Returns nothing.", 0 },
{ "list::push_front", "list::push_front( list, item )", "Inserts item at the front of the list. Returns nothing.", 0 },
{ "math::abs", "math::abs( x )", "Absolute value of x, returned as a float even for int input.", 0 },
{ "math::acos", "math::acos( x )", "Arc cosine of x, returns an angle in radians as a float.", 0 },
{ "math::asin", "math::asin( x )", "Arc sine of x, returns an angle in radians as a float.", 0 },
{ "math::atan", "math::atan( x )", "Arc tangent of x, returns an angle in radians as a float.", 0 },
{ "math::atan2", "math::atan2( y, x )", "Angle in radians of the point (x, y), in the range -pi to pi. Returns a float.", 0 },
{ "math::ceil", "math::ceil( x )", "Smallest integral value not less than x, returned as a float.", 0 },
{ "math::cos", "math::cos( radians )", "Cosine of an angle given in radians, returns a float.", 0 },
{ "math::cosh", "math::cosh( x )", "Hyperbolic cosine of x, returns a float.", 0 },
{ "math::deg2rad", "math::deg2rad( degrees )", "Converts an angle from degrees to radians, returns a float.", 0 },
{ "math::exp", "math::exp( x )", "e raised to the power x, returns a float.", 0 },
{ "math::floor", "math::floor( x )", "Largest integral value not greater than x, returned as a float.", 0 },
{ "math::fmod", "math::fmod( x, y )", "Floating point remainder of x / y, with the sign of x. Returns a float.", 0 },
{ "math::iscale", "math::iscale( a, b, divisor )", "Returns (a * b) / divisor as an int, using a 64-bit intermediate so the product does not overflow. Returns 0 if divisor is 0.", 0 },
{ "math::ldexp", "math::ldexp( x, exp )", "Returns x * 2^exp as a float; exp is converted to an int.", 0 },
{ "math::ln", "math::ln( x )", "Natural (base e) logarithm of x, returns a float. Same as math::log.", 0 },
{ "math::log", "math::log( x )", "Natural (base e) logarithm of x, returns a float.", 0 },
{ "math::log10", "math::log10( x )", "Base 10 logarithm of x, returns a float.", 0 },
{ "math::pow", "math::pow( base, exponent )", "base raised to the power exponent, returns a float.", 0 },
{ "math::rad2deg", "math::rad2deg( radians )", "Converts an angle from radians to degrees, returns a float.", 0 },
{ "math::sin", "math::sin( radians )", "Sine of an angle given in radians, returns a float.", 0 },
{ "math::sinh", "math::sinh( x )", "Hyperbolic sine of x, returns a float.", 0 },
{ "math::sqrt", "math::sqrt( x )", "Square root of x, returns a float.", 0 },
{ "math::tan", "math::tan( radians )", "Tangent of an angle given in radians, returns a float.", 0 },
{ "math::tanh", "math::tanh( x )", "Hyperbolic tangent of x, returns a float.", 0 },
{ "math::trunc", "math::trunc( x )", "Rounds x toward zero, returned as a float.", 0 },
{ "msg::clear", "msg::clear( key )", "Removes the message stored under key, if any. Returns nothing.", 0 },
{ "msg::peek", "msg::peek( key )", "Returns 1 if a message exists under key, otherwise 0.", 0 },
{ "msg::read", "msg::read( key, [clear] )", "Returns the message stored under key as it was written (an int, a float or a string), or 0 if there is none. If clear is true the message is removed after reading.", 0 },
{ "msg::write", "msg::write( key, value )", "Stores an int, float or string (a copy) under key in the mailbox shared by all contexts of the state. Returns 0, or -1 when value is a container or struct, which are not stored.", 0 },
{ "queue::clear", "queue::clear( queue )", "Turns the variable into a new empty FIFO queue (an array); call it before pushing. Returns the queue.", 0 },
{ "queue::count", "queue::count( queue )", "Returns the number of elements in the queue.", 0 },
{ "queue::peek", "queue::peek( queue )", "Returns the oldest element (the next one queue::pop returns) without removing it, or 0 if the queue is empty.", 0 },
{ "queue::pop", "queue::pop( queue )", "Removes and returns the oldest element, or returns 0 if the queue is empty.", 0 },
{ "queue::push", "queue::push( queue, item )", "Adds item to the queue. Returns nothing.", 0 },
{ "stack::clear", "stack::clear( stack )", "Turns the variable into a new empty LIFO stack (an array); call it before pushing. Returns the stack.", 0 },
{ "stack::count", "stack::count( stack )", "Returns the number of elements on the stack.", 0 },
{ "stack::peek", "stack::peek( stack )", "Returns the top (most recently pushed) element without removing it, or 0 if the stack is empty.", 0 },
{ "stack::pop", "stack::pop( stack )", "Removes and returns the top element, or returns 0 if the stack is empty.", 0 },
{ "stack::push", "stack::push( stack, item )", "Pushes item onto the top of the stack. Returns nothing.", 0 },
{ "std::deserialize", "std::deserialize( data )", "Rebuilds the value from a string produced by std::serialize. Returns 0 if data is not a string or is invalid.", 0 },
{ "std::rand", "std::rand( a, [b] )", "Returns a pseudo-random int from 0 to a, or from a to b when b is given, both ends inclusive. Returns the lower bound if it is not less than the upper one.", 0 },
{ "std::serialize", "std::serialize( value )", "Converts an int, float, string, array or hash table (nested as needed) into a binary string for storage. Returns 0 for unsupported values such as structs.", 0 },
{ "std::srand", "std::srand( seed )", "Seeds the pseudo-random generator used by std::rand, one per state. Returns nothing.", 0 },
{ "std::time", "std::time()", "Returns the current Unix time in seconds as an int (on boards without a clock: seconds since the start).", 0 },
{ "str::chr", "str::chr( str, ch )", "Returns the index of the first occurrence of character code ch in str, or -1 if it is not found.", 0 },
{ "str::concat", "str::concat( a, b )", "Returns a new string made of a followed by b; only two arguments are used. Returns 0 if either is not a string.", 0 },
{ "str::format", "str::format( fmt, ... )", "Returns a new string formatted like C sprintf: %d %i %u %x %X %o %c %s %f %F %e %E %g %G %% with the flags - + space 0 #, a width and a precision (both may be *), plus %b (binary) and %p. Length modifiers are ignored, every int is 32 bits.", 0 },
{ "str::insert", "str::insert( str, ins, pos )", "Returns a new string with ins inserted into str at index pos (clamped to the end).", 0 },
{ "str::isalnum", "str::isalnum( ch )", "Returns non-zero if character code ch is a letter or a decimal digit, otherwise 0.", 0 },
{ "str::isalpha", "str::isalpha( ch )", "Returns non-zero if character code ch is a letter, otherwise 0.", 0 },
{ "str::isdigit", "str::isdigit( ch )", "Returns non-zero if character code ch is a decimal digit, otherwise 0.", 0 },
{ "str::isspace", "str::isspace( ch )", "Returns non-zero if character code ch is whitespace, otherwise 0.", 0 },
{ "str::left", "str::left( str, count )", "Returns the first count characters of str, or the whole string if it is shorter.", 0 },
{ "str::mid", "str::mid( str, start, [count] )", "Returns count characters of str starting at index start (default: to the end). Returns an empty string if start is past the end.", 0 },
{ "str::printf", "str::printf( fmt, ... )", "Formats like str::format and writes the result to standard output. Returns the number of characters written.", 0 },
{ "str::right", "str::right( str, count )", "Returns the last count characters of str, or the whole string if it is shorter.", 0 },
{ "str::sprintf", "str::sprintf( dest, fmt, ... )", "Formats like str::format and stores the resulting string in variable dest. Returns its length.", 0 },
{ "str::strlen", "str::strlen( str )", "Returns the length of string str, or 0 if it is not a string. str._count also works.", 0 },
{ "str::substr", "str::substr( str, start, [count] )", "Returns count characters of str starting at index start (default: to the end). Same as str::mid.", 0 },
{ "str::tol", "str::tol( str, [base] )", "Parses str as an integer in base (default 10, 0 detects 0x and 0 prefixes) and returns it, clamped to INT32_MIN..INT32_MAX on every platform whatever the input length. Returns 0 if no number is found.", 0 },
{ "str::tolower", "str::tolower( value )", "Returns a lowercase copy of a string, or the lowercase character code when given an int.", 0 },
{ "str::toupper", "str::toupper( value )", "Returns an uppercase copy of a string, or the uppercase character code when given an int.", 0 },
{ "str::tprint", "str::tprint( value )", "Debug helper that prints the internal representation of value to standard output, in decimal and in hex. Returns nothing.", 0 },
{ "str::trim", "str::trim( str )", "Returns a copy of str without leading and trailing whitespace.", 0 },
{ "str::trimleft", "str::trimleft( str )", "Returns a copy of str without leading whitespace.", 0 },
{ "str::trimright", "str::trimright( str )", "Returns a copy of str without trailing whitespace.", 0 },
{ "str::trunc", "str::trunc( str, count )", "Returns the first count characters of str. Same as str::left.", 0 },
{ "sys::halt", "sys::halt( code )", "Stops the script immediately and sets the state error to code, which must be 101 to 255; other values set WR_ERR_USER_err_out_of_range.", 0 },
{ "sys::importByteCode", "sys::importByteCode( code )", "Imports compiled bytecode (a string) into the running context so its exported functions and structs can be used. Returns -1 if code is not a string or not valid bytecode, otherwise 0.", 0 },
{ "sys::importCompile", "sys::importCompile( source )", "Compiles the source string and imports it into the running context. Returns the compile error code, 0 on success; needs the compiler built in.", 0 },
{ "sys::isFunction", "sys::isFunction( name )", "Returns 1 if name is a registered native or library function, 2 if it is a function of the current script or of a module it imported, otherwise 0.", 0 },
{ "tcp::accept", "tcp::accept( socket )", "Waits for an incoming connection on a listening socket and returns the new connection socket, or -1 on error.", 0 },
{ "tcp::bind", "tcp::bind( port )", "Creates a TCP socket listening on port on all interfaces. Returns the socket or -1 on failure.", 0 },
{ "tcp::close", "tcp::close( socket )", "Closes the socket. Returns nothing.", 0 },
{ "tcp::connect", "tcp::connect( address, port )", "Connects to address (dotted IPv4 or host name) on port. Returns the socket, or -1 on failure.", 0 },
{ "tcp::peek", "tcp::peek( socket, [timeoutMs] )", "Waits up to timeoutMs (default 0) for incoming data. Returns a positive value if data is available, 0 if not, -1 on error.", 0 },
{ "tcp::receive", "tcp::receive( socket, maxBytes )", "Reads up to maxBytes from the socket and returns them as a string. Returns 0 when the connection is closed.", 0 },
{ "tcp::send", "tcp::send( socket, data )", "Sends the string data over the socket. Returns the number of bytes sent or -1 on error.", 0 },
{ "time::ms", "time::ms()", "Returns a millisecond tick count as an int that only increases (wraps at 32 bits): GetTickCount on Windows, the monotonic clock on Linux and macOS, millis() on Arduino boards, esp_timer on ESP-IDF, HAL_GetTick on STM32 HAL. Returns 0 on other platforms.", 0 },
{ "io::O_APPEND", "io::O_APPEND", "io::open flag: every write goes to the end of the file.", 1 },
{ "io::O_CREAT", "io::O_CREAT", "io::open flag: create the file if it does not exist.", 1 },
{ "io::O_EXCL", "io::O_EXCL", "io::open flag: together with io::O_CREAT, fail if the file already exists.", 1 },
{ "io::O_RDONLY", "io::O_RDONLY", "io::open flag: open for reading only.", 1 },
{ "io::O_RDWR", "io::O_RDWR", "io::open flag: open for reading and writing.", 1 },
{ "io::O_TRUNC", "io::O_TRUNC", "io::open flag: truncate an existing file to zero length.", 1 },
{ "io::O_WRONLY", "io::O_WRONLY", "io::open flag: open for writing only.", 1 },
{ "io::SEEK_CUR", "io::SEEK_CUR", "io::seek origin: offset is relative to the current position.", 1 },
{ "io::SEEK_END", "io::SEEK_END", "io::seek origin: offset is relative to the end of the file.", 1 },
{ "io::SEEK_SET", "io::SEEK_SET", "io::seek origin: offset is relative to the start of the file.", 1 },
